## Kconfig
```kconfig
# SPDX-License-Identifier: GPL-2.0-only
#
#   Embann_data_types.h - EMbedded Backpropogating Artificial Neural Network.
#   Copyright Peter Frost 2019

mainmenu "Embann Configuration"

    menu "Log output"
        choice LOG_DEFAULT_LEVEL
            bool "Default log verbosity"
            default LOG_DEFAULT_LEVEL_INFO
            help
                Specify how much output to see in logs by default.

                Note that this setting limits which log statements
                are compiled into the program. So setting this to, say,
                "Warning" would mean that changing log level to "Debug"
                at runtime will not be possible.

            config LOG_DEFAULT_LEVEL_NONE
                bool "No output"
            config LOG_DEFAULT_LEVEL_ERROR
                bool "Error"
            config LOG_DEFAULT_LEVEL_WARN
                bool "Warning"
            config LOG_DEFAULT_LEVEL_INFO
                bool "Info"
            config LOG_DEFAULT_LEVEL_DEBUG
                bool "Debug"
            config LOG_DEFAULT_LEVEL_VERBOSE
                bool "Verbose"
        endchoice

        config LOG_DEFAULT_LEVEL
            int
            default 0 if LOG_DEFAULT_LEVEL_NONE
            default 1 if LOG_DEFAULT_LEVEL_ERROR
            default 2 if LOG_DEFAULT_LEVEL_WARN
            default 3 if LOG_DEFAULT_LEVEL_INFO
            default 4 if LOG_DEFAULT_LEVEL_DEBUG
            default 5 if LOG_DEFAULT_LEVEL_VERBOSE

        config LOG_COLORS
            bool "Use ANSI terminal colors in log output"
            default "y"
            help
                Enable ANSI terminal color codes in bootloader output.

                In order to view these, your terminal program must support ANSI color codes.

    endmenu

    menu "Error Behaviour"
        choice ERROR_CHECK_BEHAVIOUR
            bool "Behaviour of the EMBANN_ERROR_CHECK macro"
            default ERROR_CHECK_SET_ERRNO
            help
                Specify what the EMBANN_ERROR_CHECK macro does if a function returns
                something other than EOK.

            config ERROR_CHECK_SET_ERRNO
                bool "Set embann_errno"
                help
                    Set the value of embann_errno variable to the error value.
            config ERROR_CHECK_RETURN
                bool "Return on error"
                help
                    Immediately returns with the error value (these are posix error values).
            config ERROR_CHECK_ABORT
                bool "Execute abort()"
                help
                    Executes the abort() function.
            config ERROR_CHECK_LOG
                bool "Log all error return values"
                help
                    Prints the return code to console, even if the return is 0 (EOK).
        endchoice

        choice MALLOC_CHECK_BEHAVIOUR
            bool "Behaviour of the EMBANN_MALLOC_CHECK macro"
            default MALLOC_CHECK_RETURN
            help
                Specify what the EMBANN_MALLOC_CHECK macro does if the pointer to
                the allocated memory is null (i.e. the allocation failed).

            config MALLOC_CHECK_RETURN
                bool "Return on error"
                help
                    Immediately returns with the error value (these are posix error values).
            config MALLOC_CHECK_ABORT
                bool "Execute abort()"
                help
                    Executes the abort() function.
        endchoice
    endmenu


    menu "Data Types"
        choice ACTIVATION_DATA_TYPE
            bool "Activation Data Type"
            default ACTIVATION_DATA_TYPE_UINT8
            help
                Select the data type use for neuron activaions.

                This will significantly impact performance depending on
                what instructions / extensions are available.

                Changing neuron data types to different essential types
                (i.e. mixing unsigned and signed, or integer and float) will
                cause MISRA C non-compliances, although this may be necassary
                to take advantage of specific assembly instructions (e.g. VPDPBUSD).

            config ACTIVATION_DATA_TYPE_INT8
                bool "Signed 8-bit Integer"
            config ACTIVATION_DATA_TYPE_INT16
                bool "Signed 16-bit Integer"
            config ACTIVATION_DATA_TYPE_INT32
                bool "Signed 32-bit Integer"
            config ACTIVATION_DATA_TYPE_INT64
                bool "Signed 64-bit Integer"
            config ACTIVATION_DATA_TYPE_UINT8
                bool "Unsigned 8-bit Integer"
            config ACTIVATION_DATA_TYPE_UINT16
                bool "Unsigned 16-bit Integer"
            config ACTIVATION_DATA_TYPE_UINT32
                bool "Unsigned 32-bit Integer"
            config ACTIVATION_DATA_TYPE_UINT64
                bool "Unsigned 64-bit Integer"
            config ACTIVATION_DATA_TYPE_FLOAT
                bool "Single-Precision Floating Point"
            config ACTIVATION_DATA_TYPE_DOUBLE
                bool "Double-Precision Floating Point"
        endchoice


        choice BIAS_DATA_TYPE
            bool "Bias Data Type"
            default BIAS_DATA_TYPE_INT32
            help
                Select the data type use for neuron biases.

                This will significantly impact performance depending on
                what instructions / extensions are available.

                Changing neuron data types to different essential types
                (i.e. mixing unsigned and signed, or integer and float) will
                cause MISRA C non-compliances, although this may be necassary
                to take advantage of specific assembly instructions (e.g. VPDPBUSD).

            config BIAS_DATA_TYPE_INT8
                bool "Signed 8-bit Integer"
            config BIAS_DATA_TYPE_INT16
                bool "Signed 16-bit Integer"
            config BIAS_DATA_TYPE_INT32
                bool "Signed 32-bit Integer"
            config BIAS_DATA_TYPE_INT64
                bool "Signed 64-bit Integer"
            config BIAS_DATA_TYPE_UINT8
                bool "Unsigned 8-bit Integer"
            config BIAS_DATA_TYPE_UINT16
                bool "Unsigned 16-bit Integer"
            config BIAS_DATA_TYPE_UINT32
                bool "Unsigned 32-bit Integer"
            config BIAS_DATA_TYPE_UINT64
                bool "Unsigned 64-bit Integer"
            config BIAS_DATA_TYPE_FLOAT
                bool "Single-Precision Floating Point"
            config BIAS_DATA_TYPE_DOUBLE
                bool "Double-Precision Floating Point"
        endchoice


        choice WEIGHT_DATA_TYPE
            bool "Weight Data Type"
            default WEIGHT_DATA_TYPE_INT8
            help
                Select the data type use for neuron weights.

                This will significantly impact performance depending on
                what instructions / extensions are available.

                Changing neuron data types to different essential types
                (i.e. mixing unsigned and signed, or integer and float) will
                cause MISRA C non-compliances, although this may be necassary
                to take advantage of specific assembly instructions (e.g. VPDPBUSD).

            config WEIGHT_DATA_TYPE_INT8
                bool "Signed 8-bit Integer"
            config WEIGHT_DATA_TYPE_INT16
                bool "Signed 16-bit Integer"
            config WEIGHT_DATA_TYPE_INT32
                bool "Signed 32-bit Integer"
            config WEIGHT_DATA_TYPE_INT64
                bool "Signed 64-bit Integer"
            config WEIGHT_DATA_TYPE_UINT8
                bool "Unsigned 8-bit Integer"
            config WEIGHT_DATA_TYPE_UINT16
                bool "Unsigned 16-bit Integer"
            config WEIGHT_DATA_TYPE_UINT32
                bool "Unsigned 32-bit Integer"
            config WEIGHT_DATA_TYPE_UINT64
                bool "Unsigned 64-bit Integer"
            config WEIGHT_DATA_TYPE_FLOAT
                bool "Single-Precision Floating Point"
            config WEIGHT_DATA_TYPE_DOUBLE
                bool "Double-Precision Floating Point"
        endchoice


        choice ACCUMULATOR_DATA_TYPE
            bool "Accumulator Data Type"
            default ACCUMULATOR_DATA_TYPE_INT32
            help
                Select the data type use for the accumulator variable when
                doing the weighed sum of all neurons in the previous layer.

                This will significantly impact performance depending on
                what instructions / extensions are available.

                Changing neuron data types to different essential types
                (i.e. mixing unsigned and signed, or integer and float) will
                cause MISRA C non-compliances, although this may be necassary
                to take advantage of specific assembly instructions (e.g. VPDPBUSD).

            config ACCUMULATOR_DATA_TYPE_INT8
                bool "Signed 8-bit Integer"
            config ACCUMULATOR_DATA_TYPE_INT16
                bool "Signed 16-bit Integer"
            config ACCUMULATOR_DATA_TYPE_INT32
                bool "Signed 32-bit Integer"
            config ACCUMULATOR_DATA_TYPE_INT64
                bool "Signed 64-bit Integer"
            config ACCUMULATOR_DATA_TYPE_UINT8
                bool "Unsigned 8-bit Integer"
            config ACCUMULATOR_DATA_TYPE_UINT16
                bool "Unsigned 16-bit Integer"
            config ACCUMULATOR_DATA_TYPE_UINT32
                bool "Unsigned 32-bit Integer"
            config ACCUMULATOR_DATA_TYPE_UINT64
                bool "Unsigned 64-bit Integer"
            config ACCUMULATOR_DATA_TYPE_FLOAT
                bool "Single-Precision Floating Point"
            config ACCUMULATOR_DATA_TYPE_DOUBLE
                bool "Double-Precision Floating Point"
        endchoice


        choice NUM_INPUTS_DATA_TYPE
            bool "Num Inputs Data Type"
            default NUM_INPUTS_DATA_TYPE_UINT16
            help
                Dictates how many input neurons can be generated
                based on the number of bits in the data type.

            config NUM_INPUTS_DATA_TYPE_UINT8
                bool "Unsigned 8-bit Integer"
            config NUM_INPUTS_DATA_TYPE_UINT16
                bool "Unsigned 16-bit Integer"
            config NUM_INPUTS_DATA_TYPE_UINT32
                bool "Unsigned 32-bit Integer"
            config NUM_INPUTS_DATA_TYPE_UINT64
                bool "Unsigned 64-bit Integer"
        endchoice

        choice NUM_HIDDEN_NEURONS_DATA_TYPE
            bool "Num Hidden Neurons Data Type"
            default NUM_HIDDEN_NEURONS_DATA_TYPE_UINT16
            help
                Dictates how many hidden neurons can be generated
                based on the number of bits in the data type.

            config NUM_HIDDEN_NEURONS_DATA_TYPE_UINT8
                bool "Unsigned 8-bit Integer"
            config NUM_HIDDEN_NEURONS_DATA_TYPE_UINT16
                bool "Unsigned 16-bit Integer"
            config NUM_HIDDEN_NEURONS_DATA_TYPE_UINT32
                bool "Unsigned 32-bit Integer"
            config NUM_HIDDEN_NEURONS_DATA_TYPE_UINT64
                bool "Unsigned 64-bit Integer"
        endchoice


        choice NUM_OUTPUTS_DATA_TYPE
            bool "Num Outputs Data Type"
            default NUM_OUTPUTS_DATA_TYPE_UINT16
            help
                Dictates how many output neurons can be generated
                based on the number of bits in the data type.

            config NUM_OUTPUTS_DATA_TYPE_UINT8
                bool "Unsigned 8-bit Integer"
            config NUM_OUTPUTS_DATA_TYPE_UINT16
                bool "Unsigned 16-bit Integer"
            config NUM_OUTPUTS_DATA_TYPE_UINT32
                bool "Unsigned 32-bit Integer"
            config NUM_OUTPUTS_DATA_TYPE_UINT64
                bool "Unsigned 64-bit Integer"
        endchoice


        choice NUM_LAYERS_DATA_TYPE
            bool "Num Layers Data Type"
            default NUM_LAYERS_DATA_TYPE_UINT8
            help
                Dictates how many layers can be generated
                based on the number of bits in the data type.

            config NUM_LAYERS_DATA_TYPE_UINT8
                bool "Unsigned 8-bit Integer"
            config NUM_LAYERS_DATA_TYPE_UINT16
                bool "Unsigned 16-bit Integer"
            config NUM_LAYERS_DATA_TYPE_UINT32
                bool "Unsigned 32-bit Integer"
            config NUM_LAYERS_DATA_TYPE_UINT64
                bool "Unsigned 64-bit Integer"
        endchoice


        choice NUM_TRAINING_DATA_ENTRIES_TYPE
            bool "Num Training Data Entries Data Type"
            default NUM_TRAINING_DATA_ENTRIES_TYPE_UINT32
            help
                Dictates how many instances of training data can
                be added to the network based on the number of 
                bits in the data type.

            config NUM_TRAINING_DATA_ENTRIES_TYPE_UINT8
                bool "Unsigned 8-bit Integer"
            config NUM_TRAINING_DATA_ENTRIES_TYPE_UINT16
                bool "Unsigned 16-bit Integer"
            config NUM_TRAINING_DATA_ENTRIES_TYPE_UINT32
                bool "Unsigned 32-bit Integer"
            config NUM_TRAINING_DATA_ENTRIES_TYPE_UINT64
                bool "Unsigned 64-bit Integer"
        endchoice
    endmenu


    menu "Memory Allocation Strategy"
        choice MEMORY_ALLOCATION_STRATEGY
            bool "Static / Dynamic Allocation"
            default MEMORY_ALLOCATION_DYNAMIC
            help
                Choose whether to statically or dynamically allocate
                memory for the neural network. Static allocation could
                be beneficial in embedded projecets which only have very
                simple heap management.

                Static allocation must be allocated at compile time, so
                network dimensions are chosen with another Kconfig menu.

                Static allocation is also neccessary for MISRA C compliance.

            config MEMORY_ALLOCATION_DYNAMIC
                bool "Dynamic Memory Allocation"
            config MEMORY_ALLOCATION_STATIC
                bool "Static Memory Allocation"
        endchoice
    endmenu

    menu "Network Dimensions"
        depends on MEMORY_ALLOCATION_STATIC

        config NUM_INPUT_NEURONS
            int "Number of Input Neurons"
            default 10
        config NUM_HIDDEN_NEURONS
            int "Number of Hidden Neurons"
            default 10
        config NUM_HIDDEN_LAYERS
            int "Number of Hidden Layers"
            default 5
        config NUM_OUTPUT_NEURONS
            int "Number of Output Neurons"
            default 3
    endmenu
```
